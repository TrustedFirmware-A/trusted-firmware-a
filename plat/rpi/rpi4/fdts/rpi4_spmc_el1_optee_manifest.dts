/* SPDX-License-Identifier: BSD-3-Clause */
/*
 * Copyright (c) 2026, Arm Limited and Contributors. All rights reserved.
 */

/dts-v1/;

/ {
	compatible = "arm,ffa-core-manifest-1.0";
	#address-cells = <2>;
	#size-cells = <2>;

	attribute {
		spmc_id = <0x8000>;
		maj_ver = <0x1>;
		min_ver = <0x2>;
		exec_state = <0x0>;
		load_address = <0x0 0x10100000>;
		entrypoint = <0x0 0x10100000>;
		binary_size = <0x00f00000>;
	};

	/* Secure world memory */
	memory@10100000 {
		device_type = "memory";
		reg = <0x0 0x10100000 0x0 0x00f00000>;
	};

	/* Non-secure memory available to the SPMC for shared memory */
	memory@0 {
		device_type = "ns-memory";
		reg = <0x0 0x0 0x0 0x10000000>,
		      <0x0 0x11000000 0x0 0x2d000000>,
		      <0x0 0x40000000 0x0 0xbc000000>,
		      <0x1 0x00000000 0x1 0x00000000>;
	};
};
